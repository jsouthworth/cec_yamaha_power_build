## cec_yamaha_power_buildroot/Config.in
```kconfig
source "$BR2_EXTERNAL_CEC_YAMAHA_POWER_PATH/package/cec_yamaha_power/Config.in"
source "$BR2_EXTERNAL_CEC_YAMAHA_POWER_PATH/package/init-cec_yamaha_power/Config.in"
source "$BR2_EXTERNAL_CEC_YAMAHA_POWER_PATH/package/skeleton-cec_yamaha_power/Config.in"
```

## cec_yamaha_power_buildroot/configs/raspi-cec-yamaha-power_defconfig
```kconfig
BR2_arm=y
BR2_cortex_a53=y
BR2_ARM_FPU_NEON_VFPV4=y

BR2_PACKAGE_MUSL=y
BR2_PACKAGE_MUSL_COMPAT_HEADERS=y
BR2_TOOLCHAIN_USES_MUSL=y
BR2_TOOLCHAIN_BUILDROOT_MUSL=y
BR2_TOOLCHAIN_BUILDROOT_LIBC="musl"

BR2_TOOLCHAIN_BUILDROOT_CXX=y
BR2_TOOLCHAIN_HAS_THREADS=y
BR2_INSTALL_LIBSTDCPP=y
BR2_USE_WCHAR=y

BR2_ROOTFS_SKELETON_DEFAULT=y
BR2_TARGET_GENERIC_HOSTNAME="cec_yamaha_power"
BR2_TARGET_GENERIC_ISSUE="CEC controled Yamaha Power"
BR2_INIT_CEC_YAMAHA_POWER=y
BR2_ROOTFS_DEVICE_CREATION_DYNAMIC_DEVTMPFS=y
BR2_ROOTFS_DEVICE_TABLE="system/device_table.txt"
BR2_ROOTFS_MERGED_USR=y
# BR2_TARGET_ENABLE_ROOT_LOGIN is not set
BR2_SYSTEM_BIN_SH_NONE=y
# BR2_TARGET_GENERIC_GETTY is not set
# BR2_TARGET_GENERIC_REMOUNT_ROOTFS_RW is not set

# BR2_PACKAGE_BUSYBOX is not set
BR2_PACKAGE_BUSYBOX_SHOW_OTHERS=y
# BR2_PACKAGE_IFUPDOWN_SCRIPTS is not set

BR2_PACKAGE_HOST_LINUX_HEADERS_CUSTOM_5_10=y
BR2_LINUX_KERNEL=y
BR2_LINUX_KERNEL_CUSTOM_TARBALL=y
BR2_LINUX_KERNEL_CUSTOM_TARBALL_LOCATION="$(call github,raspberrypi,linux,0b54dbda3cca2beb51e236a25738784e90853b64)/linux-0b54dbda3cca2beb51e236a25738784e90853b64.tar.gz"
BR2_LINUX_KERNEL_USE_CUSTOM_CONFIG=y
BR2_LINUX_KERNEL_CUSTOM_CONFIG_FILE="$(BR2_EXTERNAL_CEC_YAMAHA_POWER_PATH)/configs/kernel.config"
BR2_LINUX_KERNEL_DTS_SUPPORT=y
BR2_LINUX_KERNEL_INTREE_DTS_NAME="bcm2710-rpi-3-b bcm2710-rpi-3-b-plus bcm2710-rpi-cm3"
BR2_LINUX_KERNEL_NEEDS_HOST_OPENSSL=y

BR2_PACKAGE_SKELETON=y
BR2_PACKAGE_HAS_SKELETON=y
BR2_PACKAGE_PROVIDES_SKELETON="skeleton-cec_yamaha_power"

BR2_PACKAGE_RPI_FIRMWARE=y
BR2_PACKAGE_RPI_FIRMWARE_BOOTCODE_BIN=y
BR2_PACKAGE_RPI_FIRMWARE_VARIANT_PI=y
BR2_PACKAGE_RPI_FIRMWARE_CONFIG_FILE="$(BR2_EXTERNAL_CEC_YAMAHA_POWER_PATH)/configs/config.txt"
BR2_PACKAGE_RPI_FIRMWARE_INSTALL_DTB_OVERLAYS=y

BR2_PACKAGE_LIBCEC=y
BR2_PACKAGE_LIBPLATFORM=y
BR2_PACKAGE_CEC_YAMAHA_POWER=y
BR2_PACKAGE_INIT_CEC_YAMAHA_POWER=y
BR2_PACKAGE_SKELETON_CEC_YAMAHA_POWER=y

BR2_PACKAGE_HOST_DOSFSTOOLS=y
BR2_PACKAGE_HOST_GENIMAGE=y
BR2_PACKAGE_HOST_MTOOLS=y

BR2_TARGET_ROOTFS_EXT2=y
BR2_TARGET_ROOTFS_EXT2_4=y
BR2_TARGET_ROOTFS_EXT2_SIZE="10M"

BR2_ROOTFS_POST_BUILD_SCRIPT="board/raspberrypi3/post-build.sh"
BR2_ROOTFS_POST_IMAGE_SCRIPT="board/raspberrypi3/post-image.sh"
```

## cec_yamaha_power_buildroot/package/cec_yamaha_power/Config.in
```kconfig
config BR2_PACKAGE_CEC_YAMAHA_POWER
    bool "cec_yamaha_power"
    depends on BR2_PACKAGE_LIBCEC
    depends on BR2_PACKAGE_HOST_GO_TARGET_ARCH_SUPPORTS
    depends on BR2_PACKAGE_HOST_GO_TARGET_CGO_LINKING_SUPPORTS
    help
      CEC to IR power control for Yamaha HTR-6230
```

## cec_yamaha_power_buildroot/package/init-cec_yamaha_power/Config.in
```kconfig
config BR2_PACKAGE_INIT_CEC_YAMAHA_POWER
       bool
       depends on BR2_PACKAGE_CEC_YAMAHA_POWER
       help
         cec_yamaha_power linked to /sbin/init
```

## cec_yamaha_power_buildroot/package/skeleton-cec_yamaha_power/Config.in
```kconfig
config BR2_PACKAGE_SKELETON_CEC_YAMAHA_POWER
        bool
	select BR2_PACKAGE_HAS_SKELETON

config BR2_PACKAGE_PROVIDES_SKELETON
        default "skeleton-cec_yamaha_power" if BR2_PACKAGE_SKELETON_CEC_YAMAHA_POWER
```
